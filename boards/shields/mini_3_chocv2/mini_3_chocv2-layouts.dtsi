#include <physical_layouts.dtsi>

/ {
    physical_layout_mini_3_chocv2: physical_layout_mini_3_chocv2 {
        compatible = "zmk,physical-layout";
        display-name = "mini-3-chocv2";
        keys  //                     w   h    x    y     rot    rx    ry
            = <&key_physical_attrs 100 100    0    0       0     0     0>
            , <&key_physical_attrs 100 100  100    0       0   100     0>
            , <&key_physical_attrs 100 100  200    0       0   200     0>
            ;
    };
};
