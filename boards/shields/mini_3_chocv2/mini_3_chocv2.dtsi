#include "mini_3_chocv2-layouts.dtsi"
#include <dt-bindings/zmk/matrix_transform.h>

/ {
    matrix_transform0: matrix_transform0 {
        compatible = "zmk,matrix-transform";
        columns = <3>;
        rows = <1>;
        map = <
            RC(0,0) RC(0,1) RC(0,2)
        >;
    };
};

&physical_layout_mini_3_chocv2 {
    transform = <&matrix_transform0>;
};

